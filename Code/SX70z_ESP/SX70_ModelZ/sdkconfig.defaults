## Code/SX70z_ESP/SX70_ModelZ/sdkconfig.defaults
```kconfig
# SX-70z sdkconfig.defaults
# Only non-default settings (overrides component defaults)

CONFIG_PARTITION_TABLE_TWO_OTA_LARGE=y
CONFIG_BOOTLOADER_APP_ROLLBACK_ENABLE=y

CONFIG_ESPTOOLPY_FLASHMODE_QIO=y
CONFIG_LOG_DEFAULT_LEVEL_WARN=y
# CONFIG_COMPILER_OPTIMIZATION_DEBUG is not set

CONFIG_BT_ENABLED=y
CONFIG_BT_NIMBLE_ENABLED=y
CONFIG_WIFI_PROV_BLE_SEC_CONN=y
CONFIG_WIFI_PROV_KEEP_BLE_ON_AFTER_PROV=y

# BLE roles: Peripheral only (camera advertises, phone connects)
# CONFIG_BT_NIMBLE_ROLE_CENTRAL is not set
# CONFIG_BT_NIMBLE_ROLE_OBSERVER is not set
# CONFIG_BT_NIMBLE_ROLE_BROADCASTER is not set

# BLE GATT services: keep only GAP+DIS (required by provisioning)
# CONFIG_BT_NIMBLE_BAS_SERVICE is not set
# CONFIG_BT_NIMBLE_HR_SERVICE is not set
# CONFIG_BT_NIMBLE_ANS_SERVICE is not set
# CONFIG_BT_NIMBLE_CTS_SERVICE is not set
# CONFIG_BT_NIMBLE_HTP_SERVICE is not set
# CONFIG_BT_NIMBLE_IAS_SERVICE is not set
# CONFIG_BT_NIMBLE_LLS_SERVICE is not set
# CONFIG_BT_NIMBLE_PROX_SERVICE is not set
# CONFIG_BT_NIMBLE_SPS_SERVICE is not set
# CONFIG_BT_NIMBLE_TPS_SERVICE is not set
# CONFIG_BT_NIMBLE_IPSS_SERVICE is not set

# Trims
# CONFIG_ETH_ENABLED is not set
# CONFIG_LWIP_IPV6 is not set
# CONFIG_LWIP_SNTP is not set
# CONFIG_ESP_GDBSTUB_ENABLED is not set
# CONFIG_VFS_SUPPORT_TERMIOS is not set
# CONFIG_VFS_SUPPORT_SELECT is not set
# CONFIG_VFS_SUPPORT_DIR is not set
# CONFIG_VFS_SUPPORT_IO is not set
# CONFIG_MQTT_PROTOCOL_311 is not set
```
